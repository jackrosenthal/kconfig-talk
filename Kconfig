## Kconfig
```kconfig
menu "Compiler options"

config COMPILER_COMMAND
	string "Command or path to command for C compiler"
	default "clang"
	help
	  The path to the C compiler, or the name of the compiler in
	  the PATH.

config COMPILER_DEBUG_SYMBOLS
	bool "Enable debug symbols"
	help
	  Pass -ggdb3 to the compiler to enable debugging symbols.

config COMPILER_DEBUG_SYMBOLS_FLAG
	def_string "-ggdb3" if COMPILER_DEBUG_SYMBOLS

choice
	prompt "Optimization level"

config COMPILER_OPT_3
	bool "Optimize with -O3"

config COMPILER_OPT_2
	bool "Optimize with -O2"

config COMPILER_OPT_1
	bool "Optimize with -O1"

config COMPILER_OPT_0
	bool "Optimize with -O0"

config COMPILER_OPT_SIZE
	bool "Optimize with -Os"

endchoice # Optimization level

config COMPILER_OPT_FLAG
	string
	default "-O0" if COMPILER_OPT_0
	default "-O1" if COMPILER_OPT_1
	default "-O2" if COMPILER_OPT_2
	default "-O3" if COMPILER_OPT_3
	default "-Os" if COMPILER_OPT_SIZE

config COMPILER_ASAN
	bool "Enable the address sanitizer"
	depends on !LINK_STATIC
	help
	  Pass -fsanitize=address to the compiler.

config COMPILER_ASAN_FLAG
	def_string "-fsanitize=address" if COMPILER_ASAN

config COMPILER_WARNINGS_ARE_ERRORS
	bool "Treat warnings as errors"
	default y
	help
	  Treat all warnings as errors during compilation.

config COMPILER_WARNINGS_ARE_ERRORS_FLAG
	def_string "-Werror" if COMPILER_WARNINGS_ARE_ERRORS

config LTO
	bool "Enable LTO (link time optimization)"
	default y if !COMPILER_DEBUG_SYMBOLS
	help
	  Pass -flto to the compiler and linker.

config LTO_FLAG
	def_string "-flto" if LTO

config LINK_STATIC
	bool "Enable static linking"
	help
	  Pass -static to the linker.

config LINK_STATIC_FLAG
	def_string "-static" if LINK_STATIC

endmenu # Compiler options

config FOO
	bool "Foo feature"
	default y
	help
	  Enable the foo feature, which prints "Foo!"

config BAR
	bool "Bar feature"
	help
	  Enable the bar featur, which prints "Bar!"
```

## examples/a/Kconfig
```kconfig
config FOO
	bool "Support for foo device"
	help
	  Enable the device drivers for a foo.

config BAR
	bool "Extra bar support"
	help
	  Enable support for more features from
	  the foo device, supporting bar and baz.
```

## examples/choice/Kconfig
```kconfig
choice
	prompt "Debug log output destination"

config DEBUG_LOG_UART
	bool "Debug messages over UART"

config DEBUG_LOG_VGA
	bool "Debug messages on VGA output"

config DEBUG_LOG_TELNET
	bool "Host telnet server for debug messages"

endchoice
```

## examples/menu1/Kconfig
```kconfig
menu "My Menu"

config OPT1
	bool "Option 1"

config OPT2
	bool "Option 2"

endmenu
```
